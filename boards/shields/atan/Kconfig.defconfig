## boards/shields/atan/Kconfig.defconfig
```kconfig
# Copyright (c) 2020 The ZMK Contributors
# SPDX-License-Identifier: MIT


if SHIELD_ATAN_LEFT

config ZMK_KEYBOARD_NAME
	default "ATAN"

config ZMK_SPLIT_BLE_ROLE_CENTRAL
	default y

endif




if SHIELD_ATAN_LEFT || SHIELD_ATAN_RIGHT

config ZMK_SPLIT
	default y

endif
```

## boards/shields/atan/Kconfig.shield
```kconfig
# Copyright (c) 2020 The ZMK Contributors
# SPDX-License-Identifier: MIT

config SHIELD_ATAN_LEFT
	def_bool $(shields_list_contains,atan_left)

config SHIELD_ATAN_RIGHT
 	def_bool $(shields_list_contains,atan_right)
```
